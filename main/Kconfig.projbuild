## main/Kconfig.projbuild
```kconfig
menu "Solar Station Live Product Configuration"
    config CROWPANEL
        bool "Is CrowPanel"
        help
            Is CrowPanel
    config CROWPANEL_ADVANCE
        bool "Is CrowPanel Advance"
        help
            Is CrowPanel Advance
endmenu
```

## sdkconfig.defaults
```kconfig
CONFIG_FREERTOS_HZ=1000

CONFIG_PARTITION_TABLE_CUSTOM=y
CONFIG_PARTITION_TABLE_CUSTOM_FILENAME="partitions.csv"
CONFIG_PARTITION_TABLE_FILENAME="partitions.csv"
CONFIG_PARTITION_TABLE_OFFSET=0x8000
CONFIG_PARTITION_TABLE_MD5=y

CONFIG_LCD_RGB_RESTART_IN_VSYNC=y

CONFIG_ARDUINO_VARIANT="esp32s3"
CONFIG_ENABLE_ARDUINO_DEPENDS=y
CONFIG_AUTOSTART_ARDUINO=y
CONFIG_ARDUINO_LOOP_STACK_SIZE=24576
```
